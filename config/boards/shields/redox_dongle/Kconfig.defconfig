## config/boards/shields/redox_dongle/Kconfig.defconfig
```kconfig
if SHIELD_REDOX_DONGLE

# Max 16 characters
config ZMK_KEYBOARD_NAME
    default "Redox"

config ZMK_SPLIT_ROLE_CENTRAL
    default y

config ZMK_SPLIT
    default y

# Two halves => 2 peripherals
config ZMK_SPLIT_BLE_CENTRAL_PERIPHERALS
    default 2

# peripherals (2) + BT profiles (5)
config BT_MAX_CONN
    default 7

config BT_MAX_PAIRED
    default 7

endif
```

## config/west.yml
```yaml
manifest:
  remotes:
    - name: zmkfirmware
      url-base: https://github.com/zmkfirmware
  projects:
    - name: zmk
      remote: zmkfirmware
      revision: 0331b7d16e80954b807917f9323e59ffc1e3b626 # main
      import: app/west.yml
    - name: zephyr
      remote: zmkfirmware
      revision: 58a5874a446ace2893a196848282d271a551e512 # v4.1.0+zmk-fixes
      clone-depth: 1
      import:
        name-allowlist:
          - cmsis
          - hal_nordic
          - mbedtls
          - tinycrypt
  self:
    path: config
```
